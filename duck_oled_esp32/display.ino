void displayGearFet() {
  display.setCursor(0, 0);
  display.setTextSize(4);
  if (digitalRead(GEAR_4))
    display.print("4");
  else if (digitalRead(GEAR_3))
    display.print("3");
  else if (digitalRead(GEAR_2))
    display.print("2");
  else if (digitalRead(GEAR_1))
    display.print("1");
  else if (digitalRead(GEAR_N))
    display.print("N");
  else
    display.print("#");
}

void diplayTemps() {
  display.setCursor(27, 16);
  display.print("         ");
  display.setTextSize(2);
  display.setCursor(27, 16);
  display.print("M");
  display.print(motorTemp, 0);
  display.setCursor(82, 16);
  display.print("A");
  display.print(envTemp, 0);
}

void displayClock() {
  display.setCursor(48, 0);
  if (curTime.hour() < 10)  display.print("0");
  display.print(curTime.hour(), DEC);
  if (dots)  display.print(':');
  else  display.print(' ');
  if (curTime.minute() < 10)  display.print("0");
  display.print(curTime.minute(), DEC);
}

#ifdef SHOW_LOGOS
const unsigned char kawasaki [] PROGMEM = {
  0xfc, 0x0f, 0xe0, 0x00, 0x00, 0x00, 0x00, 0x00, 0x00, 0x00, 0x00, 0x00, 0x00, 0x7e, 0x00, 0x3f,
  0xfe, 0x1f, 0xe0, 0x00, 0x00, 0x00, 0x00, 0x00, 0x00, 0x00, 0x00, 0x00, 0x00, 0x7e, 0x00, 0x3f,
  0xfe, 0x3f, 0xc0, 0x00, 0x00, 0x00, 0x00, 0x00, 0x00, 0x00, 0x00, 0x00, 0x00, 0x7e, 0x00, 0x3f,
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  0xfe, 0x0f, 0xf7, 0xf3, 0xf1, 0xf8, 0x7e, 0x1f, 0xcf, 0xcf, 0xfc, 0x1f, 0x9f, 0xfe, 0x1f, 0xff
};

const unsigned char kazer [] PROGMEM = {
  0x00, 0x00, 0x00, 0x00, 0x00, 0x00, 0x00, 0x00, 0x00, 0x00, 0xfc, 0x00, 0x00, 0x01, 0xff, 0xe0,
  0x00, 0x00, 0x00, 0x00, 0x00, 0x00, 0x00, 0x00, 0x00, 0x03, 0xe3, 0x00, 0x00, 0x3f, 0xff, 0xfe,
  0x00, 0x00, 0x00, 0x00, 0x00, 0x00, 0x00, 0x00, 0x00, 0x06, 0x03, 0xf0, 0x03, 0xff, 0x81, 0xff,
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  0x00, 0x00, 0x00, 0x00, 0x00, 0x00, 0x00, 0x00, 0x00, 0x03, 0xf8, 0x00, 0x00, 0x00, 0x00, 0x00
};

void displayBootSeq() {
  display.drawBitmap(0, 5, kawasaki, 128, 20, WHITE);
  display.display();
  delay(1500);

  display.clearDisplay();
  display.display();
  delay(100);

  display.clearDisplay();
  display.drawBitmap(0, 1, kazer, 128, 30, WHITE);
  display.display();
  delay(1500);

  display.clearDisplay();
  display.display();
  delay(100);
}
#endif
